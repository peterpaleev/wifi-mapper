## firmware/sdkconfig.defaults
```kconfig
CONFIG_IDF_TARGET="esp32s3"
CONFIG_ESPTOOLPY_FLASHSIZE_8MB=y
CONFIG_PARTITION_TABLE_SINGLE_APP_LARGE=y
CONFIG_SPIRAM=y
CONFIG_SPIRAM_MODE_OCT=y
CONFIG_SPIRAM_SPEED_80M=y
CONFIG_SPIRAM_IGNORE_NOTFOUND=y
CONFIG_BT_ENABLED=y
CONFIG_BT_NIMBLE_ENABLED=y
CONFIG_BT_NIMBLE_MAX_CONNECTIONS=1
CONFIG_BT_NIMBLE_ATT_PREFERRED_MTU=247
CONFIG_BT_NIMBLE_PINNED_TO_CORE_1=y
CONFIG_BT_CTRL_PINNED_TO_CORE_1=y
CONFIG_ESP_COEX_SW_COEXIST_ENABLE=y
CONFIG_ESP_WIFI_TASK_PINNED_TO_CORE_0=y
CONFIG_FREERTOS_HZ=1000
CONFIG_ESP_MAIN_TASK_STACK_SIZE=8192
CONFIG_ESP_CONSOLE_UART_DEFAULT=y
CONFIG_TINYUSB_NET_MODE_ECM_RNDIS=y
CONFIG_TINYUSB_CDC_ENABLED=n
CONFIG_COMPILER_OPTIMIZATION_PERF=y
CONFIG_TINYUSB_DESC_MANUFACTURER_STRING="WiFi Mapper"
CONFIG_TINYUSB_DESC_PRODUCT_STRING="WiFi Mapper USB Ethernet"
CONFIG_TINYUSB_DESC_SERIAL_STRING="WFM-S3-01"
```
